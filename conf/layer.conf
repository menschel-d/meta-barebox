## conf/layer.conf
```bitbake
# We have a conf and classes directory, add to BBPATH
BBPATH .= ":${LAYERDIR}"

# We have recipes-* directories, add to BBFILES
BBFILES += "${LAYERDIR}/recipes-*/*/*.bb \
            ${LAYERDIR}/recipes-*/*/*.bbappend"

BBFILE_COLLECTIONS += "barebox"
BBFILE_PATTERN_barebox = "^${LAYERDIR}/"
BBFILE_PRIORITY_barebox = "6"

LAYERDEPENDS_barebox = "core"
LAYERSERIES_COMPAT_barebox = "kirkstone"
```
